## Kconfig
```kconfig
config ZMK_BEHAVIOR_DELAYED_RELEASE
    bool
    default y
    depends on DT_HAS_ZMK_BEHAVIOR_DELAYED_RELEASE_ENABLED
```

## dts/bindings/behaviors/zmk,behavior-delayed-release.yaml
```yaml
description: Delayed Release Behavior

compatible: "zmk,behavior-delayed-release"

include: one_param.yaml

properties:
  bindings:
    type: phandle-array
    required: true
```
